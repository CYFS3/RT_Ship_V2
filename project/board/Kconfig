## project/board/Kconfig
```kconfig
menu "Hardware Drivers Config"

config SOC_STM32F103RE
    bool
    select SOC_SERIES_STM32F1
    select RT_USING_COMPONENTS_INIT
    select RT_USING_USER_MAIN
    default y

menu "Onboard Peripheral Drivers"
    menuconfig BSP_USING_DS18B20
        bool "Enable DS18B20"
        default y
        select PKG_USING_DS18B20
        select RT_USING_PIN
        if BSP_USING_DS18B20 && PKG_USING_DS18B20
            config BSP_DS18B20_PIN 
                int "DS18B20 Pin"
                default 36
        endif
    menuconfig BSP_USING_DHT11
        bool "Enable DHT11"
        default y
        select PKG_USING_DHT11
        select RT_USING_PIN
        if BSP_USING_DHT11 && PKG_USING_DHT11
            config BSP_DHT11_PIN 
                int "DHT11 Pin"
                default 4
        endif
    menuconfig BSP_USING_LC29H
        bool "Enable LC29H"
        default y
        select PKG_USING_LC29H
        select RT_USING_UART2
        select BSP_UART2_RX_USING_DMA
        select PKG_USING_GPS_RMC
        if BSP_USING_LC29H
            config BSP_LC29H_UART
                string "LC29H UART"
                default "uart2"
            config BSP_LC29H_RB_BUSIZ
                int "LC29H Rx Buffer Size"
                default 2048
        endif
        
        

endmenu

menu "On-chip Peripheral Drivers"

    config BSP_USING_GPIO
        bool "Enable GPIO"
        select RT_USING_PIN
        default y

    menuconfig BSP_USING_UART
        bool "Enable UART"
        default y
        select RT_USING_SERIAL
        if BSP_USING_UART
            config BSP_USING_UART1
                bool "Enable UART1"
                default y

            config BSP_UART1_RX_USING_DMA
                bool "Enable UART1 RX DMA"
                depends on BSP_USING_UART1 && RT_SERIAL_USING_DMA
                default n
            
            config BSP_USING_UART2
                bool "Enable UART2"
                default y

            config BSP_UART2_RX_USING_DMA
                bool "Enable UART2 RX DMA"
                depends on BSP_USING_UART2 && RT_SERIAL_USING_DMA
                default n
            
            config BSP_USING_UART3
                bool "Enable UART3"
                default y

            config BSP_UART3_RX_USING_DMA
                bool "Enable UART3 RX DMA"
                depends on BSP_USING_UART3 && RT_SERIAL_USING_DMA
                default n
            config BSP_USING_UART4
                bool "Enable UART4"
                default y

            config BSP_UART4_RX_USING_DMA
                bool "Enable UART4 RX DMA"
                depends on BSP_USING_UART4 && RT_SERIAL_USING_DMA
                default n
            
            config BSP_USING_UART5
                bool "Enable UART5"
                default y

            config BSP_UART5_RX_USING_DMA
                bool "Enable UART5 RX DMA"
                depends on BSP_USING_UART5 && RT_SERIAL_USING_DMA
                default n
            
        endif
    menuconfig BSP_USING_ADC
        bool "Enable ADC"
        default y
        select RT_USING_ADC
        if BSP_USING_ADC
            config BSP_USING_ADC1
                bool "Enacble ADC1"
                default y
        endif
    menuconfig BSP_USING_PWM
        bool "Enable PWM"
        default n
        select RT_USING_PWM
        if BSP_USING_PWM
        menuconfig BSP_USING_PWM3
            bool "Enable timer3 output PWM"
            default n
            if BSP_USING_PWM3
                config BSP_USING_PWM3_CH3
                    bool "Enable PWM3 channel3"
                    default n
            endif
        
        endif

    source "$(BSP_DIR)/libraries/HAL_Drivers/drivers/Kconfig"

endmenu

menu "Board extended module Drivers"

endmenu

endmenu
```
